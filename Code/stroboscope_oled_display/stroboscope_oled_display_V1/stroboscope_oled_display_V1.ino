// Stroboscope with oled display
// the frequency can be changed with two push-buttons
// the pulselength can be changed by pressing both buttons simultaneously

// Started from https://www.instructables.com/id/Portable-Precision-Stroboscope/
// Added ssd1306 oled

#define LOGO_HEIGHT   64
#define LOGO_WIDTH    128
static const unsigned char PROGMEM logo_bmp[] =
{ 
  B00000000,B00000000,B00000000,B00000000,B00000000,B00000000,B00000000,B00000000,B00000000,B00000000,B00000000,B00000000,B00000000,B00000000,B00000000,B00000000,
  B00000000,B00000000,B00000000,B00000000,B00000000,B00000000,B00000000,B00000000,B00000000,B00000000,B00000000,B00000000,B00000000,B00000000,B00000000,B00000000,
  B00000000,B00000000,B00000000,B00000000,B00000000,B00000000,B00000000,B00000000,B00000000,B00000000,B00000000,B00000000,B00000000,B00000000,B00000000,B00000000,
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  B00000000,B00000000,B00000000,B00000000,B00000000,B00000000,B00000000,B00000000,B00000000,B00000000,B00000000,B00000000,B00000000,B00000000,B00000000,B00000000 };

#include <SPI.h>
#include <Wire.h>
#include <Adafruit_GFX.h>
#include <Adafruit_SSD1306.h>

#define SCREEN_WIDTH 128 // OLED display width, in pixels
#define SCREEN_HEIGHT 64 // OLED display height, in pixels

// Declaration for SSD1306 display connected using software SPI (default case):
#define OLED_MOSI   11
#define OLED_CLK   13
#define OLED_DC    9
#define OLED_CS    3
#define OLED_RESET 8
Adafruit_SSD1306 display(SCREEN_WIDTH, SCREEN_HEIGHT,
  OLED_MOSI, OLED_CLK, OLED_DC, OLED_RESET, OLED_CS);


//breadboard setup 
const byte button_up=5;
const byte button_dw=6;

long freq=200; //frequency in units of 0.1Hz
byte len=1;   //pulselength in units of 64 microseconds


void testdrawbitmap(void) {
  display.clearDisplay();

  display.drawBitmap(
    (display.width()  - LOGO_WIDTH ) / 2,
    (display.height() - LOGO_HEIGHT) / 2,
    logo_bmp, LOGO_WIDTH, LOGO_HEIGHT, 1);
  display.display();
  delay(1000);
}


void testscrolltext(void) {
  display.clearDisplay();

  display.setTextSize(2); // Draw 2X-scale text
  display.setTextColor(SSD1306_WHITE);
  display.setCursor(10, 0);
  display.println(F("Papas Inventeurs"));
  display.display();      // Show initial text
  delay(100);

  // Scroll in various directions, pausing in-between:
  display.startscrollright(0x00, 0x0F);
  delay(2000);
  display.stopscroll();
  delay(1000);
  display.startscrollleft(0x00, 0x0F);
  delay(2000);
  display.stopscroll();
  delay(1000);
  display.startscrolldiagright(0x00, 0x07);
  delay(2000);
  display.startscrolldiagleft(0x00, 0x07);
  delay(2000);
  display.stopscroll();
  delay(1000);
}

void setup() {


  // SSD1306_SWITCHCAPVCC = generate display voltage from 3.3V internally
  if(!display.begin(SSD1306_SWITCHCAPVCC)) {
    Serial.println(F("SSD1306 allocation failed"));
    for(;;); // Don't proceed, loop forever
  }


  // Show initial display buffer contents on the screen --
  // the library initializes this with an Adafruit splash screen.
  //display.display();
  //delay(2000); // Pause for 2 seconds

  // Clear the buffer
  display.clearDisplay();
  display.clearDisplay();display.display();
  display.setTextSize(2);             
  display.setTextColor(SSD1306_WHITE);        // Draw white text
  display.setCursor(0,0);             // Start at top-left corner
      display.println(freq/10.0); 
    display.println(len);     display.display();
  
  //setup TIMER1B for fast PWM with (output on pin D10)
  TCCR1A=B00100010;
  TCCR1B=B00011000;
  setfreq(freq,len);
  pinMode(10,OUTPUT);

  //set the pushbuttons to input with pull-up
  pinMode(button_up,INPUT_PULLUP);
  pinMode(button_dw,INPUT_PULLUP);

  testdrawbitmap();    // Draw a small bitmap image

  // Invert and restore display, pausing in-between
  //display.invertDisplay(true);
  //delay(1000);
  //display.invertDisplay(false);
  //delay(1000);

  //testscrolltext();    // Draw scrolling text
    
}

//set frequency in Hz, pulse length in units of 64mus
void setfreq(int f, int len){

  //calculate what to put into the timing registers
  long unsigned int ticks=(160000000+f/2)/f; // f_clock/0.1f
  unsigned int ps=1;
  if (ticks>    0xFFFF)ps=   8;
  if (ticks>  8*0xFFFF)ps=  64;
  if (ticks> 64*0xFFFF)ps= 256;
  if (ticks>256*0xFFFF)ps=1024;
  unsigned int val_ICR1=ticks/ps-1;
  unsigned int val_OCR1B=len*(1024/ps)-1;
  unsigned int val_TCCR1B=B00011001;
  if (ps==   8) val_TCCR1B=B00011010;
  if (ps==  64) val_TCCR1B=B00011011;
  if (ps== 256) val_TCCR1B=B00011100;
  if (ps==1024) val_TCCR1B=B00011101;

  //set the actual values in the timing registers
  //noInterrupts();
  if (TCNT1>val_ICR1)TCNT1=0;  //do not allow timer to exceed 'top'
  ICR1=val_ICR1;
  OCR1B=val_OCR1B;
  TCCR1B=val_TCCR1B;
  //interrupts();
}

byte prevbutstat=0;

unsigned long millis_butchanged=0;
unsigned long millis_valchanged=0;

void loop() {

  //check for buttons
  long unsigned millis_current=millis();
  bool change=false;
  byte butstat=(digitalRead(button_up)==LOW)*1+(digitalRead(button_dw)==LOW)*2;
  if (butstat!=prevbutstat)millis_butchanged=millis_current;

  int dt=200; int df=1;
  if (millis_current-millis_butchanged>1000)dt=100;
  if (millis_current-millis_butchanged>2000)dt=50;
  if (millis_current-millis_butchanged>3000)dt=20;
  if (millis_current-millis_butchanged>4000)dt=10;
  if (millis_current-millis_butchanged>5000)dt=5;
  if (millis_current-millis_butchanged>6000)dt=2;
  if (millis_current-millis_butchanged>7000)dt=1;
  if (millis_current-millis_butchanged>8000)df=2;
  if (millis_current-millis_butchanged>9000)df=5;
  if (millis_current-millis_butchanged>10000)df=10;
  if (butstat==3)dt=1000;
  if(millis_current-millis_valchanged>dt){
    if(butstat==1) freq=freq+df;
    if(butstat==2) freq=freq-df;
    if(butstat==3) len++;
    if(butstat>0){
        change=true; millis_valchanged=millis_current;
    }
  }
  prevbutstat=butstat;

  //keep frequency and pulselength wihin allowed domain
  freq=max(freq,3);    
  freq=min(freq,9999);
  if (len>15)len=1;
  if (len*freq>15625)len=1; //corresponds to 0.1 duty cycle
  
  if (change){
    setfreq(freq,len);
    display.clearDisplay();
    display.setCursor(0,0);             // Start at top-left corner
    display.print(freq/10.0);display.println("Hz");
    display.print(freq*6);display.println("RPM");
    display.print(len); display.print(": ");
    display.print(len*0.064);
    display.println("ms");
    display.print((len*0.064)/(100.0/freq));
    display.println("%");
    display.display();
  }

  
 


    
}
